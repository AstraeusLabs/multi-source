## CMakeLists.txt
```
# SPDX-License-Identifier: Apache-2.0

cmake_minimum_required(VERSION 3.20.0)

find_package(Zephyr REQUIRED HINTS $ENV{ZEPHYR_BASE})
project(fixed_source)

FILE(GLOB app_sources src/*.c)
target_sources(app PRIVATE ${app_sources})

set(gen_dir ${ZEPHYR_BINARY_DIR}/include/generated/)

set(FREQS 0200;0250;0320;0400;0500;0800;1000;1600;2000;4000)

# 16 KHz samples
foreach(F IN LISTS FREQS)
        generate_inc_file_for_target(app
        src/Sine${F}Hz_1s_16.lc3
        ${gen_dir}/Sine${F}Hz_1s_16.lc3.inc)
endforeach()

# 24 KHz samples
foreach(F IN LISTS FREQS)
        generate_inc_file_for_target(app
        src/Sine${F}Hz_1s_24.lc3
        ${gen_dir}/Sine${F}Hz_1s_24.lc3.inc)
endforeach()

# 48 KHz samples
foreach(F IN LISTS FREQS)
        generate_inc_file_for_target(app
        src/Sine${F}Hz_1s_48.lc3
        ${gen_dir}/Sine${F}Hz_1s_48.lc3.inc)
endforeach()
```

## Kconfig
```
# Copyright (c) 2023 Demant A/S
# Copyright (c) 2023 Nordic Semiconductor ASA
# SPDX-License-Identifier: Apache-2.0

mainmenu "Bluetooth: Broadcast Audio Source"

choice BASE_CONFIGURATION
	prompt "The BASE configuration to be used"
#	default BASE_CONFIG_24S_16S

config BASE_CONFIG_24S_16S
	bool "24 KHz stereo and 16 KHz stereo"
	help
	  Using the BASE_CONFIG_24S_16S configuration.

config BASE_CONFIG_1_16S
	bool "16 KHz stereo in one subgroup"
	help
	  Using the BASE_CONFIG_1_16S configuration.

config BASE_CONFIG_1_24S
	bool "24 KHz stereo in one subgroup"
	help
	  Using the BASE_CONFIG_1_24S configuration.

config BASE_CONFIG_1_48S
	bool "48 KHz stereo in one subgroup"
	help
	  Using the BASE_CONFIG_1_48S configuration.

config BASE_CONFIG_48S_24M
	bool "48 KHz stereo and 24 KHz mono"
	help
	  Using the BASE_CONFIG_48S_24M configuration.

config BASE_CONFIG_48S_24S
	bool "48 KHz stereo and 24 KHz stereo"
	help
	  Using the BASE_CONFIG_48S_24S configuration.

config BASE_CONFIG_5_16M
	bool "5 subgroups with 16 KHz mono"
	help
	  Using the BASE_CONFIG_5_16M configuration.

config BASE_CONFIG_2_16M
	bool "2 subgroups with 16 KHz mono"
	help
	  Using the BASE_CONFIG_2_16M configuration.

config BASE_CONFIG_24M_16M
	bool "24 KHz mono and 16 KHz mono"
	help
	  Using the BASE_CONFIG_24M_16M configuration.

config BASE_CONFIG_48M_24M
	bool "48 KHz mono and 24 KHz mono"
	help
	  Using the BASE_CONFIG_48M_24M configuration.

config BASE_CONFIG_1_16FL
	bool "1 subgroup with 16 KHz Front Left"
	help
	  Using the BASE_CONFIG_1_16FL configuration.

config BASE_CONFIG_1_48FL
	bool "1 subgroup with 48 KHz Front Left"
	help
	  Using the BASE_CONFIG_1_48FL configuration.

endchoice

config BROADCAST_CODE
	string "The broadcast code (if any) to use for encrypted broadcast"
	default ""
	help
	   Setting a non-empty string for this option will encrypt the broadcast using this
	   string as the broadcast code. The length of the string shall be between 1 and 16 octets.

source "Kconfig.zephyr"
```

## prj.conf
```kconfig
# Broadcast Audio Source
CONFIG_BT=y
CONFIG_LOG=y
CONFIG_BT_AUDIO=y
CONFIG_BT_BAP_BROADCAST_SOURCE=y

CONFIG_BT_ISO_MAX_CHAN=4
CONFIG_BT_BAP_BROADCAST_SRC_STREAM_COUNT=4
CONFIG_BT_BAP_BROADCAST_SRC_SUBGROUP_COUNT=2
CONFIG_BT_AUDIO_CODEC_CFG_MAX_METADATA_SIZE=100

CONFIG_BT_ISO_TX_BUF_COUNT=12
CONFIG_BT_ISO_TX_MTU=100

CONFIG_BASE64=y

CONFIG_BT_DEVICE_NAME="Multi-Source"
CONFIG_PWM=y
# Default sample frequency for the source is 16 KHz
# Enable the following to build a 24 KHz source
# CONFIG_BAP_BROADCAST_24_2_1=y

CONFIG_MAIN_STACK_SIZE=8192
```

## base_1_16fl.conf
```kconfig
# Config overlay for 1 x 16 Front Left BIS
CONFIG_BASE_CONFIG_1_16FL=y
CONFIG_BT_BAP_BROADCAST_SRC_STREAM_COUNT=1
CONFIG_BT_BAP_BROADCAST_SRC_SUBGROUP_COUNT=1
```

## base_1_16m.conf
```kconfig
# Config overlay for 1 x 16 Mono BIS
CONFIG_BASE_CONFIG_1_16M=y
CONFIG_BT_BAP_BROADCAST_SRC_STREAM_COUNT=1
CONFIG_BT_BAP_BROADCAST_SRC_SUBGROUP_COUNT=1
```

## base_1_16s.conf
```kconfig
# Config overlay for 1 x 16 stereo BIS
CONFIG_BASE_CONFIG_1_16S=y
CONFIG_BT_BAP_BROADCAST_SRC_STREAM_COUNT=2
CONFIG_BT_BAP_BROADCAST_SRC_SUBGROUP_COUNT=1
```

## base_1_24m.conf
```kconfig
# Config overlay for 1 x 24 Mono BIS
CONFIG_BASE_CONFIG_1_24M=y
CONFIG_BT_BAP_BROADCAST_SRC_STREAM_COUNT=1
CONFIG_BT_BAP_BROADCAST_SRC_SUBGROUP_COUNT=1
```

## base_1_24s.conf
```kconfig
# Config overlay for 1 x 24 stereo BIS
CONFIG_BASE_CONFIG_1_24S=y
CONFIG_BT_BAP_BROADCAST_SRC_STREAM_COUNT=2
CONFIG_BT_BAP_BROADCAST_SRC_SUBGROUP_COUNT=1
```

## base_1_48fl.conf
```kconfig
# Config overlay for 1 x 48 Front Left BIS
CONFIG_BASE_CONFIG_1_48FL=y
CONFIG_BT_BAP_BROADCAST_SRC_STREAM_COUNT=1
CONFIG_BT_BAP_BROADCAST_SRC_SUBGROUP_COUNT=1
```

## src/rgb_led.c
```c
/*
 * Copyright (c) 2024 Lars Knudsen
 *
 * SPDX-License-Identifier: Apache-2.0
 */

 #include <zephyr/kernel.h>
 #include <zephyr/sys/printk.h>
 #include <zephyr/device.h>
 #include <zephyr/drivers/pwm.h>
 
 #include "rgb_led.h"
 
 #define PERIOD (USEC_PER_SEC / 100)
 
 static const struct pwm_dt_spec red_pwm_led =
     PWM_DT_SPEC_GET(DT_ALIAS(red_pwm_led));
 static const struct pwm_dt_spec green_pwm_led =
     PWM_DT_SPEC_GET(DT_ALIAS(green_pwm_led));
 static const struct pwm_dt_spec blue_pwm_led =
     PWM_DT_SPEC_GET(DT_ALIAS(blue_pwm_led));
 
 int rgb_led_init()
 {
     if (!device_is_ready(red_pwm_led.dev) ||
         !device_is_ready(green_pwm_led.dev) ||
         !device_is_ready(blue_pwm_led.dev)) {
         return -ENODEV;
     }
 
     return 0;
 }
 
 void rgb_led_set(uint8_t r, uint8_t g, uint8_t b)
 {
     uint32_t pulse_red, pulse_green, pulse_blue;
 
     pulse_red = (red_pwm_led.period >> 8) * r;
     pulse_green = (green_pwm_led.period >> 8) * g;
     pulse_blue = (blue_pwm_led.period >> 8) * b;
 
     if (pwm_set_pulse_dt(&red_pwm_led, pulse_red) != 0 ||
         pwm_set_pulse_dt(&green_pwm_led, pulse_green) != 0 ||
         pwm_set_pulse_dt(&blue_pwm_led, pulse_blue) != 0) {
         printk("Error setting RGB PWM\n");
     }
 }
```

## src/rgb_led.h
```c
#ifndef __RGB_LED_H__
#define __RGB_LED_H__

#include <zephyr/types.h>

int rgb_led_init();
void rgb_led_set(uint8_t r, uint8_t g, uint8_t b);

#endif /* __RGB_LED_H_ */
```

## src/sine_data.h
```c
/**
 * Include different sine wave blocks in different qualities
 * to allow frequency identification on sink side.
 */

/* Sine wave blocks, 16 KHz sample rate */
static const uint8_t lc3_sine_0200_16[] = {
#include "Sine0200Hz_1s_16.lc3.inc"
};
static const uint8_t lc3_sine_0250_16[] = {
#include "Sine0250Hz_1s_16.lc3.inc"
};
static const uint8_t lc3_sine_0320_16[] = {
#include "Sine0320Hz_1s_16.lc3.inc"
};
static const uint8_t lc3_sine_0400_16[] = {
#include "Sine0400Hz_1s_16.lc3.inc"
};
static const uint8_t lc3_sine_0500_16[] = {
#include "Sine0500Hz_1s_16.lc3.inc"
};
static const uint8_t lc3_sine_0800_16[] = {
#include "Sine0800Hz_1s_16.lc3.inc"
};
static const uint8_t lc3_sine_1000_16[] = {
#include "Sine1000Hz_1s_16.lc3.inc"
};
static const uint8_t lc3_sine_1600_16[] = {
#include "Sine1600Hz_1s_16.lc3.inc"
};
static const uint8_t lc3_sine_2000_16[] = {
#include "Sine2000Hz_1s_16.lc3.inc"
};
static const uint8_t lc3_sine_4000_16[] = {
#include "Sine4000Hz_1s_16.lc3.inc"
};

/* Sine wave blocks, 24 KHz sample rate */
static const uint8_t lc3_sine_0200_24[] = {
#include "Sine0200Hz_1s_24.lc3.inc"
};
static const uint8_t lc3_sine_0250_24[] = {
#include "Sine0250Hz_1s_24.lc3.inc"
};
static const uint8_t lc3_sine_0320_24[] = {
#include "Sine0320Hz_1s_24.lc3.inc"
};
static const uint8_t lc3_sine_0400_24[] = {
#include "Sine0400Hz_1s_24.lc3.inc"
};
static const uint8_t lc3_sine_0500_24[] = {
#include "Sine0500Hz_1s_24.lc3.inc"
};
static const uint8_t lc3_sine_0800_24[] = {
#include "Sine0800Hz_1s_24.lc3.inc"
};
static const uint8_t lc3_sine_1000_24[] = {
#include "Sine1000Hz_1s_24.lc3.inc"
};
static const uint8_t lc3_sine_1600_24[] = {
#include "Sine1600Hz_1s_24.lc3.inc"
};
static const uint8_t lc3_sine_2000_24[] = {
#include "Sine2000Hz_1s_24.lc3.inc"
};
static const uint8_t lc3_sine_4000_24[] = {
#include "Sine4000Hz_1s_24.lc3.inc"
};

/* Sine wave blocks, 48 KHz sample rate */
static const uint8_t lc3_sine_0200_48[] = {
#include "Sine0200Hz_1s_48.lc3.inc"
};
static const uint8_t lc3_sine_0250_48[] = {
#include "Sine0250Hz_1s_48.lc3.inc"
};
static const uint8_t lc3_sine_0320_48[] = {
#include "Sine0320Hz_1s_48.lc3.inc"
};
static const uint8_t lc3_sine_0400_48[] = {
#include "Sine0400Hz_1s_48.lc3.inc"
};
static const uint8_t lc3_sine_0500_48[] = {
#include "Sine0500Hz_1s_48.lc3.inc"
};
static const uint8_t lc3_sine_0800_48[] = {
#include "Sine0800Hz_1s_48.lc3.inc"
};
static const uint8_t lc3_sine_1000_48[] = {
#include "Sine1000Hz_1s_48.lc3.inc"
};
static const uint8_t lc3_sine_1600_48[] = {
#include "Sine1600Hz_1s_48.lc3.inc"
};
static const uint8_t lc3_sine_2000_48[] = {
#include "Sine2000Hz_1s_48.lc3.inc"
};
static const uint8_t lc3_sine_4000_48[] = {
#include "Sine4000Hz_1s_48.lc3.inc"
};
```
